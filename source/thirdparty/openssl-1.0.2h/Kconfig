## source/thirdparty/openssl-1.0.2h/Kconfig
```kconfig
config LOSCFG_TOOLS_OPENSSL
    bool "Enable OpenSSL-1.0.2h"
    default y
    depends on LOSCFG_PRODUCT_IPCAMERA && LOSCFG_DEBUG_VERSION && LOSCFG_SHELL
    help
      Answer Y to enable LiteOS support openssl tool.
```
